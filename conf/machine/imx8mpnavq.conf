## conf/machine/imx8mpnavq.conf
```bitbake
#@TYPE: Machine
#@NAME: NXP i.MX8MPlus LPDDR4 NDM Evaluation Kit
#@SOC: i.MX8MP
#@DESCRIPTION: Machine configuration for NXP i.MX8MPlus LPDDR4 EVK in NDM
#@MAINTAINER: Pascal Mareau <pascal.mareau@nxp.com>

require conf/machine/include/imx8mp-navq.inc

# The device tree name is implicit for LPDDR4, so can't use MACHINE here
KERNEL_DEVICETREE_BASENAME = "imx8mp-navq"
KERNEL_DEVICETREE = " \
                     freescale/${KERNEL_DEVICETREE_BASENAME}.dtb \
"

UBOOT_CONFIG_BASENAME = "navqp"
UBOOT_CONFIG[sd] = "${UBOOT_CONFIG_BASENAME}_defconfig,sdcard"

# Set DDR FIRMWARE
DDR_FIRMWARE_VERSION = "202006"
DDR_FIRMWARE_NAME = " \
	lpddr4_pmu_train_1d_dmem_${DDR_FIRMWARE_VERSION}.bin \
	lpddr4_pmu_train_1d_imem_${DDR_FIRMWARE_VERSION}.bin \
	lpddr4_pmu_train_2d_dmem_${DDR_FIRMWARE_VERSION}.bin \
	lpddr4_pmu_train_2d_imem_${DDR_FIRMWARE_VERSION}.bin \
"

# Set u-boot DTB
UBOOT_DTB_NAME = "imx8mp-navqp.dtb"
IMXBOOT_TARGETS_BASENAME = "flash_evk"

MACHINE_FIRMWARE += " linux-firmware-sr150 "

KERNEL_MODULE_AUTOLOAD  += "mlan moal"
KERNEL_MODULE_PROBECONF += "moal"
module_conf_moal = "options moal fw_name=nxp/sdiouart8987_combo_v0.bin \
cal_data_cfg=none drv_mode=1 cfg80211_wext=0xf \
sta_name=wlan wfd_name=p2p max_vir_bss=1 auto_ds=2 ps_mode=2 drvdbg=0x00000000"
```
